## config/boards/shields/hgi/Kconfig.defconfig
```kconfig
# Copyright (c) 2022 The ZMK Contributors
# SPDX-License-Identifier: MIT

if SHIELD_HGI_LEFT

config ZMK_KEYBOARD_NAME
    default "HGI"

config ZMK_SPLIT_ROLE_CENTRAL
    default y

endif

if SHIELD_HGI_LEFT || SHIELD_HGI_RIGHT
config ZMK_SPLIT
    default y
endif
```

## config/boards/shields/hgi/Kconfig.shield
```kconfig
# Copyright (c) 2022 The ZMK Contributors
# SPDX-License-Identifier: MIT

config SHIELD_HGI_LEFT
    def_bool $(shields_list_contains,hgi_left)

config SHIELD_HGI_RIGHT
    def_bool $(shields_list_contains,hgi_right)
```
